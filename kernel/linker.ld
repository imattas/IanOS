ENTRY(_start)

SECTIONS
{
    . = 0x100000;
    __kernel_start = .;

    .text ALIGN(0x1000) : {
        *(.text.start)
        *(.text .text.*)
    }

    .rodata ALIGN(0x1000) : {
        *(.rodata .rodata.*)
    }

    .data ALIGN(0x1000) : {
        *(.data .data.*)
    }

    .bss ALIGN(0x1000) : {
        __bss_start = .;
        *(COMMON)
        *(.bss .bss.*)
        __bss_end = .;
    }

    __kernel_end = .;
}
